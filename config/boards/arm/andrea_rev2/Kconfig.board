## config/boards/arm/andrea_rev2/Kconfig.board
```kconfig
# Andrea board configuration

# Copyright (c) 2020 The ZMK Contributors
# SPDX-License-Identifier: MIT

config BOARD_ANDREA_REV2
	bool "Andrea"
	depends on SOC_NRF52840_QIAA
```

## config/boards/arm/andrea_rev2/Kconfig.txt
```kconfig
# Andrea board configuration

# Copyright (c) 2020 The ZMK Contributors
# SPDX-License-Identifier: MIT

config BOARD_ANDREA_REV2
	bool "Andrea Keyboard"
	depends on SOC_NRF52840_QIAA
```

## config/west.yml
```yaml
manifest:
  remotes:
    - name: zmkfirmware
      url-base: https://github.com/zmkfirmware
    - name: ramonimbao
      url-base: https://github.com/ramonimbao
  projects:
    - name: zmk
      remote: zmkfirmware
      revision: main
      import: app/west.yml
  self:
    path: config
```
